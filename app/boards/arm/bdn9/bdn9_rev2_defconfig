## app/boards/arm/bdn9/bdn9_rev2_defconfig
```kconfig
# SPDX-License-Identifier: MIT

CONFIG_SOC_SERIES_STM32F0X=y
CONFIG_SOC_STM32F072XB=y
# 72MHz system clock
CONFIG_SYS_CLOCK_HW_CYCLES_PER_SEC=72000000

# Floating Point Options
CONFIG_FPU=y

# enable GPIO
CONFIG_GPIO=y

# Enable pinmux
CONFIG_PINMUX=y

# Needed to reduce this to size that will fit on F072
CONFIG_HEAP_MEM_POOL_SIZE=1024

# clock configuration
CONFIG_CLOCK_CONTROL=y
```

## app/boards/arm/draculady/Kconfig.board
```kconfig
# Draculady board configuration

# Copyright (c) 2020 @MangoIV
# SPDX-License-Identifier: MIT


config BOARD_DRACULADY_RIGHT
	bool "draculady_right"
	depends on SOC_NRF52840_QIAA

config BOARD_DRACULADY_LEFT
	bool "draculady_left"
	depends on SOC_NRF52840_QIAA
```

## app/boards/arm/draculady/Kconfig.defconfig
```kconfig
if BOARD_DRACULADY_LEFT

config ZMK_KEYBOARD_NAME
    default "Draculady Left"

endif #LEFT

if BOARD_DRACULADY_RIGHT

config ZMK_KEYBOARD_NAME
    default "Draculady"

endif #RIGHT


if BOARD_DRACULADY_LEFT || BOARD_DRACULADY_RIGHT

config BOARD
	default "draculady"

config ZMK_SPLIT
    default y

config ZMK_USB
	default y

if USB

config USB_NRFX
	default y

config USB_DEVICE_STACK
	default y

endif # USB

config BT_CTLR
	default BT

config ZMK_BLE
	default y

config ZMK_USB
	default y

config ZMK_BATTERY_VOLTAGE_DIVIDER
	default y


endif
```

## app/boards/shields/pinsel/Kconfig.defconfig
```kconfig
# Copyright (c) 2020 The ZMK Contributors
# SPDX-License-Identifier: MIT

if SHIELD_PINSEL_LEFT

config ZMK_KEYBOARD_NAME
    default "Pinsel Left"

endif

if SHIELD_PINSEL_RIGHT

config ZMK_KEYBOARD_NAME
    default "Pinsel Right"

endif

if SHIELD_PINSEL_RIGHT || SHIELD_PINSEL_LEFT

config ZMK_USB
    default y

config ZMK_SPLIT
    default y

endif
```
