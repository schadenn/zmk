
#include "draculady.dtsi"


&kscan0 {
    col-gpios
        = <&gpio1  9 GPIO_ACTIVE_HIGH>
        , <&gpio0  8 GPIO_ACTIVE_HIGH>
        , <&gpio0  6 GPIO_ACTIVE_HIGH>
        , <&gpio0  4 GPIO_ACTIVE_HIGH>
        , <&gpio0 26 GPIO_ACTIVE_HIGH>
        ;
};

&right_encoder {
    status = "okay";
};

&transform {
    col-offset = <5>;
};
