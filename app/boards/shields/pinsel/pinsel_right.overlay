/*
 * Copyright (c) 2020 The ZMK Contributors
 *
 * SPDX-License-Identifier: MIT
 */

#include pinsel.dtsi
&kscan{
    col-gpios
        = <&porta  4 GPIO_ACTIVE_HIGH>
        , <&porta 10 GPIO_ACTIVE_HIGH>
        , <&porta 11 GPIO_ACTIVE_HIGH>
        , <&portb  8 GPIO_ACTIVE_HIGH>
        , <&porta  2 GPIO_ACTIVE_HIGH>
        ;
};
